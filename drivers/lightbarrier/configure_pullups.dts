/dts-v1/;
/plugin/;

/ {
    compatible = "brcm,bcm2708";

    fragment@0 {
        target = <&gpio>;
        __overlay__ {
            pinctrl-names = "default";
            pinctrl-0 = <&my_pins>;

            my_pins: my_pins {
                brcm,pins = <20 21>;     /* GPIO20,21 */
                brcm,function = <0 0>; /* Input */
                brcm,pull = <2 2>;     /* Pull up */         
            };
        };
    };
};